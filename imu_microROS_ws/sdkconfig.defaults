## imu_microROS_ws/sdkconfig.defaults
```kconfig
CONFIG_MICRO_ROS_ESP_XRCE_DDS_MIDDLEWARE=y
CONFIG_MICRO_ROS_ESP_NETIF_WLAN=y
CONFIG_ESP_WIFI_SSID="test_microros"
CONFIG_ESP_WIFI_PASSWORD="helloworld"
CONFIG_MICRO_ROS_AGENT_IP="10.146.11.196"
CONFIG_MICRO_ROS_AGENT_PORT="8888"
```
